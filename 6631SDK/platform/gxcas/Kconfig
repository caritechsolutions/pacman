## 6631SDK/platform/gxdownloader/configs/nos_defconfig
```kconfig
CONFIG_DEMOD_GX1121D=y
CONFIG_DEMOD_GX3211=y
CONFIG_DEMOD_GX1001=y
CONFIG_DEMOD_GX1503B_DVBC=y
CONFIG_DEMOD_GX1503B_DTMB=y
CONFIG_DEMOD_GX3211_DVBC=y
CONFIG_DEMOD_ATBM888X_DVBC=y
CONFIG_DEMOD_ATBM888X_DTMB=y
CONFIG_DEMOD_ATBM783X_DVBC=y
CONFIG_DEMOD_ATBM783X_DVBS=y
CONFIG_DEMOD_ATBM78X_DVBT=y
CONFIG_DEMOD_ATBM78X_DVBC=y
CONFIG_DEMOD_ATBM78X_REPEAT_DVBT=y
CONFIG_DEMOD_ATBM78X_REPEAT_DVBC=y
CONFIG_DEMOD_GX1133=y
CONFIG_DEMOD_Sirius_DVBS=y
CONFIG_DEMOD_Sirius_DVBC=y
CONFIG_DEMOD_Sirius_J83B=y
CONFIG_DEMOD_Taurus_DVBS=y
CONFIG_DEMOD_Taurus_DVBC=y
CONFIG_DEMOD_Taurus_J83B=y
CONFIG_DEMOD_Gemini_DVBT=y
CONFIG_DEMOD_Gemini_DVBC=y
CONFIG_DEMOD_Cygnus_DVBT=y
CONFIG_DEMOD_Cygnus_DVBC=y
CONFIG_DEMOD_MXL683=y
CONFIG_DEMOD_GX1135_DVBS=y
CONFIG_DEMOD_Canopus_DVBS=y
CONFIG_DEMOD_Canopus_DVBC=y
CONFIG_DEMOD_Canopus_J83B=y
CONFIG_DEMOD_Canopus_DVBC1=y
CONFIG_DEMOD_Cygnus_FM=y
CONFIG_DEMOD_CXD2856_DVBT=y
CONFIG_DEMOD_CXD2856_DVBC=y
CONFIG_DEMOD_CXD2856_REPEAT_DVBT=y
CONFIG_DEMOD_CXD2856_REPEAT_DVBC=y
CONFIG_DEMOD_SI2183_DVBT=y
CONFIG_DEMOD_SI2183_DVBC=y
CONFIG_DEMOD_Vega_DVBS=y
CONFIG_DEMOD_Vega_DVBC=y
CONFIG_DEMOD_Vega_J83B=y
CONFIG_DEMOD_Vega_DVBC1=y
CONFIG_DEMOD_Scorpio_DVBC=y
CONFIG_TUNER_AV2018=y
CONFIG_TUNER_AV2020=y
CONFIG_TUNER_MXL608_DVBT=y
CONFIG_TUNER_MXL608_DTMB=y
CONFIG_TUNER_MXL608_DVBC=y
CONFIG_TUNER_TDA18250=y
CONFIG_TUNER_TDA18250A=y
CONFIG_TUNER_TDA18273_DTMB=y
CONFIG_TUNER_TDA18273_DVBC=y
CONFIG_TUNER_R850_R836_DTMB=y
CONFIG_TUNER_R850_R836_DVBC=y
CONFIG_TUNER_R850_R836_DVBT=y
CONFIG_TUNER_R910_DTMB=y
CONFIG_TUNER_R910_DVBC=y
CONFIG_TUNER_SI2141_DTMB=y
CONFIG_TUNER_SI2141_DVBC=y
CONFIG_TUNER_SI2141_DVBT=y
CONFIG_TUNER_R848_DVBS=y
CONFIG_TUNER_R848_DVBC=y
CONFIG_TUNER_R848_DVBT=y
CONFIG_TUNER_R848_DTMB=y
CONFIG_TUNER_RDA5815M=y
CONFIG_TUNER_ATBM2040=y
CONFIG_TUNER_ATBM2030=y
CONFIG_TUNER_SHARP7306=y
CONFIG_TUNER_ATBM253_DTMB=y
CONFIG_TUNER_ATBM253_DVBT=y
CONFIG_TUNER_ATBM253_DVBC=y
CONFIG_TUNER_RDA5880U_DTMB=y
CONFIG_TUNER_RDA5880U_DVBT=y
CONFIG_TUNER_RDA5880U_DVBC=y
CONFIG_TUNER_ATBM2040_DTMB=y
CONFIG_TUNER_ATBM2040_DVBT=y
CONFIG_TUNER_ATBM2040_DVBC=y
CONFIG_TUNER_TS6011=y
CONFIG_TUNER_M3031=y
CONFIG_TUNER_RDA5160_DTMB=y
CONFIG_TUNER_RDA5160_DVBC=y
CONFIG_TUNER_RDA5160_DVBT=y
CONFIG_TUNER_RT720=y
CONFIG_TUNER_MTV600=y
CONFIG_TUNER_A3500=y
CONFIG_TUNER_R858_DVBC_1ST=y
CONFIG_TUNER_R858_DVBC_2ND=y
```

## 6631SDK/platform/gxdownloader/configs/scorpio-taurus_nos_defconfig
```kconfig
CONFIG_SCORPIO_TAURUS=y
CONFIG_DEMOD_Scorpio_DVBC=y
CONFIG_DEMOD_Taurus_DVBC=y
CONFIG_TUNER_R850_R836_DVBC=y
```

## 6631SDK/solution/Config.in
```kconfig
# Blacker, liujh@nationalchip.com
# Copyleft (C) 2013, 2014, HangZhou Nationalchip Tech
# Fork from Opensource Project [BUILDROOT]
# thanks to Opensource Code Website, such as github.com

mainmenu "NationalChip DVB-S2 HD STB Application Configuration"

config BR2_HAVE_DOT_CONFIG
	bool
	default y

config BR2_VERSION
	string
	option env="BR2_VERSION_FULL"

config BR2_HOSTARCH
	string
	option env="HOSTARCH"

choice
	prompt "STB Decoder Chip"
	default BR2_CHIP_GX3201
	help
	  Select a decoder chip of NatioinalChip.

#   config BR2_CHIP_GX6602
#       bool "GX6602"
#       help
#       This is the 2nd generation STB HD decoder chip.
#       For twin tuner, DVB-S/S2 enhanced applications
#       DVB-S2 integrated
#       DDR3 16bits
#       USB X 3
#       SmartCard X 1
#       HDMI&CVBS&YPbPr output
#       10/100M Ethernet
#       Nand&SPI Flash
#       55nm LQFP216
#
#   config BR2_CHIP_GX6601
#       bool "GX6601"
#       help
#       This is the 2nd generation STB HD decoder chip.
#       For DVB-S/S2 basic applications
#       DVB-S2 integrated
#       DDR3 16bits
#       USB X 2
#       SmartCard X 1
#       HDMI&CVBS output
#       SPI Flash
#       5GPIO
#       55nm LQFP128

config BR2_CHIP_GX3201
	bool "GX3201"
	help
	  This is the 2nd generation STB HD decoder chip.
	  For DVB-C basic applications
	  55nm LQFP128

config BR2_CHIP_GX3211
	bool "GX3211"

config BR2_CHIP_SIRIUS
	bool "SIRIUS"

config BR2_CHIP_CANOPUS
	bool "CANOPUS"

config BR2_CHIP_VEGA
	bool "VEGA"

config BR2_CHIP_TAURUS
	bool "TAURUS"

config BR2_CHIP_SCORPIO
	bool "SCORPIO"

config BR2_CHIP_SCORPIOTAURUS
	bool "SCORPIO-TAURUS"

config BR2_CHIP_GEMINI
	bool "GEMINI"

config BR2_CHIP_CYGNUS
	bool "CYGNUS"

config BR2_CHIP_GX6605S
	bool "GX6605S"

endchoice

config BR2_CHIP_NAME
	string
	#default "gx6602" if BR2_CHIP_GX6602
	#default "gx6601" if BR2_CHIP_GX6601
	default "gx3211" if BR2_CHIP_GX3211
	default "sirius" if BR2_CHIP_SIRIUS
    default "canopus" if BR2_CHIP_CANOPUS
	default "vega"   if BR2_CHIP_VEGA
	default "scorpio" if BR2_CHIP_SCORPIO
	default "taurus" if BR2_CHIP_TAURUS
	default "gemini" if BR2_CHIP_GEMINI
	default "cygnus" if BR2_CHIP_CYGNUS
	default "gx3201" if BR2_CHIP_GX3201
	default "gx6605s" if BR2_CHIP_GX6605S
	default "scorpio-taurus" if BR2_CHIP_SCORPIOTAURUS
	#default "gx3113" if BR2_CHIP_GX3113

choice
	prompt "Operating System"
	default BR2_OS_LINUX
	help
	  Select an OS for the application.

config BR2_OS_ECOS
	bool "eCOS"
	help
	  eCOS Operating System

config BR2_OS_LINUX
	bool "Linux"
	help
	  Linux Operating System

endchoice

config BR2_OS_NAME
	string
	default "ecos" if BR2_OS_ECOS
	default "linux" if BR2_OS_LINUX


# Project Definition
source system/configin/Config.in

#choice
#	prompt "Terminal Type"
#	default BR2_TYPE_STB
#	help
#	  Select device type.

#config BR2_TYPE_STB
#	bool "STB"
#	help
#	  Device - Set Top Box

#config BR2_TYPE_IPTV
#	bool "IPTV"
#	help
#	  Device - IPTV

#config BR2_TYPE_NETPLAYER
#	bool "NetPlayer"
#	help
#	  Device - Net Player

#config BR2_TYPE_MEDIAPLAYER
#	bool "MediaPlayer"
#	help
#	  Device - Media Player

#endchoice
```

## 6631SDK/solution/system/configin/Config.in
```kconfig
config BR2_PROJ_NAME
	string

menu "Project Configuration"
source system/configin/Config.in.proj
endmenu

menu "Theme Configuration"
source system/configin/Config.in.theme
source system/configin/Config.in.lang
endmenu

#if BR2_PROJ_NAME !=  ""
#source system/configin/Config.in.board
if BR2_TUNER_TYPE != "ott"
source system/configin/Config.in.demod
endif
source system/configin/Config.in.module
source system/configin/Config.in.secure
source system/configin/Config.in.debug
#endif
```
